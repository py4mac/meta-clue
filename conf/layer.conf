## conf/layer.conf
```bitbake
# We have a conf and classes directory, add to BBPATH
BBPATH .= ":${LAYERDIR}"

# We have recipes-* directories, add to BBFILES
BBFILES += "${LAYERDIR}/recipes-*/*/*.bb \
            ${LAYERDIR}/recipes-*/*/*.bbappend"

BBFILE_COLLECTIONS += "meta-noclue"
BBFILE_PATTERN_meta-noclue = "^${LAYERDIR}/"
BBFILE_PRIORITY_meta-noclue = "6"

LAYERDEPENDS_meta-noclue = "core"
LAYERSERIES_COMPAT_meta-noclue = "dunfell"
```
